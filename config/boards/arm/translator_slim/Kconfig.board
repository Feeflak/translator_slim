## config/boards/arm/translator_slim/Kconfig.board
```kconfig
config BOARD_TRANSLATOR_SLIM
    bool "Translator Slim"
    depends on SOC_NRF52840_QIAA
```

## config/boards/arm/translator_slim/Kconfig.defconfig
```kconfig
if BOARD_TRANSLATOR_SLIM

config BOARD
    default "translator_slim"

endif # BOARD_TRANSLATOR_SLIM
```
